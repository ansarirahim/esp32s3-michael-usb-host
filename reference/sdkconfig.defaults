## sdkconfig.defaults
```kconfig
# ESP32-S3 USB Host Automator - SDK Configuration
# Project: USB Host Mode Automation for Michael Steinmann
# Date: November 2025

# ============================================================================
# CHIP CONFIGURATION
# ============================================================================
CONFIG_IDF_TARGET="esp32s3"
CONFIG_IDF_TARGET_ESP32S3=y

# ============================================================================
# FLASH CONFIGURATION
# ============================================================================
CONFIG_ESPTOOLPY_FLASHMODE_DIO=y
CONFIG_ESPTOOLPY_FLASHFREQ_80M=y
CONFIG_ESPTOOLPY_FLASHSIZE_8MB=y

# ============================================================================
# PARTITION TABLE
# ============================================================================
CONFIG_PARTITION_TABLE_CUSTOM=y
CONFIG_PARTITION_TABLE_CUSTOM_FILENAME="partitions.csv"

# ============================================================================
# USB CONFIGURATION
# ============================================================================
CONFIG_USB_OTG_SUPPORTED=y
CONFIG_USB_HOST_CONTROL_TRANSFER_MAX_SIZE=256
CONFIG_USB_HOST_HUB_REQUIRED=n

# ============================================================================
# WATCHDOG CONFIGURATION (Increase timeout for USB ISR processing)
# ============================================================================
CONFIG_ESP_INT_WDT_TIMEOUT_MS=800
CONFIG_ESP_TASK_WDT_TIMEOUT_S=10

# TinyUSB Configuration (esp_tinyusb component)
# NOTE: TinyUSB is ONLY used for Device mode
# Host mode uses separate ESP-IDF USB Host library
CONFIG_TINYUSB_TASK_STACK_SIZE=4096
CONFIG_TINYUSB_TASK_PRIORITY=18

# USB Device MSC Configuration
CONFIG_TINYUSB_MSC_ENABLED=y
CONFIG_TINYUSB_MSC_BUFSIZE=512
CONFIG_TINYUSB_MSC_MOUNT_PATH="/data"

# FAT Format Configuration (use FAT12 for small partitions <256KB)
# CONFIG_TINYUSB_FAT_FORMAT_ANY is not set
# CONFIG_TINYUSB_FAT_FORMAT_FAT32 is not set
CONFIG_TINYUSB_FAT_FORMAT_SFD=y

# ============================================================================
# WEAR LEVELING CONFIGURATION
# ============================================================================
# Set sector size to 512 bytes to match TinyUSB MSC expectations
CONFIG_WL_SECTOR_SIZE=512

# ============================================================================
# FILESYSTEM CONFIGURATION
# ============================================================================
# FAT Filesystem
CONFIG_FATFS_SECTOR_512=y
CONFIG_FATFS_LFN_HEAP=y
CONFIG_FATFS_MAX_LFN=255
CONFIG_FATFS_FS_LOCK=4

# SPIFFS Filesystem
CONFIG_SPIFFS_MAX_PARTITIONS=1
CONFIG_SPIFFS_USE_MAGIC=y
CONFIG_SPIFFS_USE_MAGIC_LENGTH=y
CONFIG_SPIFFS_CACHE=y
CONFIG_SPIFFS_CACHE_WR=y
CONFIG_SPIFFS_PAGE_CHECK=y

# ============================================================================
# FREERTOS CONFIGURATION
# ============================================================================
CONFIG_ESP_MAIN_TASK_STACK_SIZE=8192
CONFIG_FREERTOS_TIMER_TASK_STACK_DEPTH=4096
CONFIG_ESP_TIMER_TASK_STACK_SIZE=3584
CONFIG_ESP_IPC_TASK_STACK_SIZE=2048

# ============================================================================
# LOGGING CONFIGURATION
# ============================================================================
CONFIG_LOG_DEFAULT_LEVEL=3
CONFIG_LOG_DEFAULT_LEVEL_INFO=y

# ============================================================================
# FREERTOS CONFIGURATION
# ============================================================================
CONFIG_FREERTOS_UNICORE=n
CONFIG_FREERTOS_TASK_STACK_SIZE_DEFAULT=3072

# ============================================================================
# PSRAM CONFIGURATION
# ============================================================================
# PSRAM disabled - not all boards have PSRAM
CONFIG_SPIRAM=n

# ============================================================================
# SECURITY CONFIGURATION
# ============================================================================
CONFIG_SECURE_BOOT_ENABLED=n
CONFIG_SECURE_FLASH_ENC_ENABLED=n

# ============================================================================
# PERFORMANCE CONFIGURATION
# ============================================================================
CONFIG_ESP32S3_DEFAULT_CPU_FREQ_240=y
```
